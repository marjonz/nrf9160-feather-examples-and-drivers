## prj.conf
```kconfig
# Heap and stacks
CONFIG_HEAP_MEM_POOL_SIZE=8192
CONFIG_MAIN_STACK_SIZE=4096
CONFIG_SYSTEM_WORKQUEUE_STACK_SIZE=2048

# New Libc
CONFIG_NEWLIB_LIBC=y
CONFIG_NEWLIB_LIBC_FLOAT_PRINTF=y

# Network
CONFIG_NETWORKING=y
CONFIG_NET_NATIVE=n
CONFIG_NET_SOCKETS=y
CONFIG_NET_SOCKETS_OFFLOAD=y
CONFIG_POSIX_API=y
CONFIG_NET_IPV6=n
CONFIG_NET_IPV4=y

# LTE link control
CONFIG_LTE_LINK_CONTROL=y
CONFIG_LTE_NETWORK_MODE_LTE_M_GPS=y

# PSM enable
CONFIG_LTE_LC_PSM_MODULE=y
CONFIG_LTE_PSM_REQ=y
CONFIG_LTE_PSM_REQ_RPTAU="00100110" # 6 hour
CONFIG_LTE_PSM_REQ_RAT="00000011" # 6 sec active time

# Modem library
CONFIG_NRF_MODEM_LIB=y
CONFIG_NRF_MODEM_LIB_TRACE=n
CONFIG_MODEM_KEY_MGMT=y

# Date Time library
CONFIG_DATE_TIME=y

# Logging
CONFIG_LOG=y
# CONFIG_LOG_MODE_IMMEDIATE=y

# cJSON
CONFIG_CJSON_LIB=y

# HTTP
CONFIG_HTTP_CLIENT=y

# Debug
# CONFIG_ASSERT=y
# CONFIG_RESET_ON_FATAL_ERROR=n

# Change host
#CONFIG_CLOUD_HOSTNAME="yourhostname.com"
CONFIG_CLOUD_HOSTNAME="xyzubiri.synology.me"
CONFIG_CLOUD_PUBLISH_PATH="/api/device/data"
CONFIG_CLOUD_PORT=443
```

## src/main.c
```c
/*
 * Copyright (c) 2020 Circuit Dojo LLC
 *
 * SPDX-License-Identifier: Apache-2.0
 */

#include <zephyr/kernel.h>
#include <zephyr/pm/device.h>
#include <zephyr/logging/log.h>
LOG_MODULE_REGISTER(main);

/* nRF Libraries */
#include <modem/nrf_modem_lib.h>
#include <modem/lte_lc.h>
#include <modem/modem_info.h>

/* Local */
#include "cloud/cloud.h"

#define CONFIG_RETRY_DELAY_MINUTES 1

/* Timer */
static void timeout_handler(struct k_timer *timer_id);
K_TIMER_DEFINE(timer, timeout_handler, NULL);

/* Thread control */
K_SEM_DEFINE(thread_sem, 0, 1);
K_SEM_DEFINE(lte_connected, 0, 1);

/* Variables */
static struct device_data data = {
    .do_something = true,
};

void cloud_cb(struct device_data *p_data)
{
    LOG_INF("Cloud callback");

    /* TODO: handle data here */
}

static void timeout_handler(struct k_timer *timer_id)
{
    LOG_INF("Main loop going back to sleep");
    k_sem_give(&thread_sem);
}

static void lte_handler(const struct lte_lc_evt *evt)
{
    switch (evt->type) {
    case LTE_LC_EVT_NW_REG_STATUS:
        if ((evt->nw_reg_status == LTE_LC_NW_REG_REGISTERED_HOME) ||
            (evt->nw_reg_status == LTE_LC_NW_REG_REGISTERED_ROAMING)) 
        {
            LOG_INF("LTE connected to network.");
            k_sem_give(&lte_connected);
        }
        break;

    default:
        break;
    }
}

int main(void)
{
    int err;

    LOG_INF("HTTPS Sample. Board: %s", CONFIG_BOARD);

    /* Register callback handler to handler LTE events */
    lte_lc_register_handler(lte_handler);

    /* Init modem lib */
    err = nrf_modem_lib_init();
    if (err < 0)
    {
        LOG_ERR("Failed to init modem lib. (err: %i)", err);
        return err;
    }

    /* Cloud init */
    err = cloud_init(cloud_cb);
    if (err < 0)
    {
        LOG_ERR("Unable to set callback. Err: %i", err);
        return err;
    }

    /* Power saving is turned on */
    lte_lc_psm_req(true);

    /* Connect */
    LOG_INF("Connecting to LTE...");
    err = lte_lc_connect();
    /* Wait indefinitely (or add timeout?) */
    k_sem_take(&lte_connected, K_FOREVER);
    if (err < 0)
    {
        LOG_ERR("Failed to connect. Err: %i", err);
        return err;
    }

    LOG_INF("Safe to use sockets now. LTE is connected.");

    /* Start timer to periodically wake the device and publish data */
    k_timer_start(&timer, K_MINUTES(CONFIG_DEFAULT_DELAY), K_MINUTES(CONFIG_DEFAULT_DELAY));

    /* Allow for instant publish */
    k_sem_give(&thread_sem);

    while (1)
    {
        k_sem_take(&thread_sem, K_FOREVER);

        /* Publish and sleep .. */
        err = cloud_publish(&data);
        if (err < 0)
        {
            LOG_ERR("Unable to publish. Err: %i", err);
            // Stop the current timer and attempt to republish in CONFIG_RETRY_DELAY_MINUTES minutes
            k_timer_stop(&timer);
            k_timer_start(&timer, K_MINUTES(CONFIG_RETRY_DELAY_MINUTES), K_MINUTES(CONFIG_RETRY_DELAY_MINUTES));
        }
        else
        {
            LOG_INF("Cloud publish successful.");
            // Stop the current timer and republish in the normal default delay interval
            k_timer_stop(&timer);
            k_timer_start(&timer, K_MINUTES(CONFIG_DEFAULT_DELAY), K_MINUTES(CONFIG_DEFAULT_DELAY));
        }
    }
}
```
