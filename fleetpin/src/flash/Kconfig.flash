## fleetpin/src/flash/Kconfig.flash
```kconfig
# Copyright (c) 2019 Peter Bigot Consulting, LLC
# SPDX-License-Identifier: Apache-2.0
# https://github.com/circuitdojo/nrf9160-feather-examples-and-drivers/blob/7e1a44fd8569e15f14aab56117317359d664eff5/samples/external_flash/Kconfig

mainmenu "littlefs sample"

config APP_WIPE_STORAGE
	bool "Option to clear the flash area before mounting"
	help
	  Use this to force an existing file system to be created.
```

## west.yml
```yaml
# Import requirements for nRF9160 Feather Examples and Drivers
manifest:
  remotes:
    - name: nrfconnect
      url-base: https://github.com/nrfconnect
  projects:
    - name: nrf
      repo-path: sdk-nrf
      remote: nrfconnect
      revision: v3.0.1
      import:
        name-blocklist:
          - matter
          - nrf-802154
          - openthread
          - cmock
          - unity
          - cddl-gen
          - homekit
          - loramac-node
          - lz4
          - lvgl
          - mipi-sys-t
      clone-depth: 1
    # RTC Driver
    - name: pcf85063a
      url: https://github.com/circuitdojo/pcf85063a
      revision: 81c1c285970df5bbdae945ee0ca12ec56f1886e6
      path: pcf85063a

    - name: uzlib
      url: https://github.com/pfalcon/uzlib.git
      revision: 27e4f4c15ba30c2cfc89575159e8efb50f95037e
      path: nfed/fleetpin/src/lib/uzlib 

    - name: miniz
      url: https://github.com/mongoose-os-libs/miniz.git
      revision: 3fc768770d6cd35de5538f5d76c1824b9941285c
      path: nfed/fleetpin/src/lib/miniz
  self:
    # This repository should be cloned to nrf9160-feather
    path: nfed
```
